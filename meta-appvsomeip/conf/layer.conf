## meta-appvsomeip/conf/layer.conf
```bitbake
# We have a conf and classes directory, add to BBPATH
BBPATH .= ":${LAYERDIR}"

# We have recipes-* directories, add to BBFILES
BBFILES += "${LAYERDIR}/recipes-*/*/*.bb \
            ${LAYERDIR}/recipes-*/*/*.bbappend"

BBFILE_COLLECTIONS += "meta-appvsomeip"
BBFILE_PATTERN_meta-appvsomeip = "^${LAYERDIR}/"
BBFILE_PRIORITY_meta-appvsomeip = "6"

LAYERDEPENDS_meta-appvsomeip = "core"
LAYERSERIES_COMPAT_meta-appvsomeip = "mickledore"
```

## meta-vsomeip/conf/layer.conf
```bitbake
# We have a conf and classes directory, add to BBPATH
BBPATH .= ":${LAYERDIR}"

# We have recipes-* directories, add to BBFILES
BBFILES += "${LAYERDIR}/recipes-*/*/*.bb \
            ${LAYERDIR}/recipes-*/*/*.bbappend"

BBFILE_COLLECTIONS += "meta-vsomeip"
BBFILE_PATTERN_meta-vsomeip = "^${LAYERDIR}/"
BBFILE_PRIORITY_meta-vsomeip = "6"

LAYERDEPENDS_meta-vsomeip = "core"
LAYERSERIES_COMPAT_meta-vsomeip = "mickledore"
```
